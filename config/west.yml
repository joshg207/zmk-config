## config/west.yml
```yaml
manifest:
  remotes:
    - name: zmkfirmware
      url-base: https://github.com/zmkfirmware
    - name: mctechnology17
      url-base: https://github.com/mctechnology17
    - name: prospector
      url-base: https://github.com/t-ogura

  projects:
    - name: zmk
      remote: zmkfirmware
      revision: main
      import: app/west.yml

    # Display & IO modules
    - name: zmk-nice-oled
      remote: mctechnology17
      revision: main

    - name: zmk-dongle-display-view
      remote: mctechnology17
      revision: main

    - name: zmk-oled-adapter
      remote: mctechnology17
      revision: main

    # Keyboard-specific modules
    - name: prospector-zmk-module
      remote: prospector
      revision: v2.2.1
      path: modules/prospector-zmk-module

  self:
    path: config
```

## zephyr/dts/bindings/zmk,behavior-one-shot.yaml
```yaml
title: "ZMK behavior-one-shot binding"

description: "Minimal binding for ZMK one-shot behavior to satisfy DTS parsing in this repo."

properties:
  layer:
    description: "Layer index to activate as one-shot"
    type: integer

required: []

additionalProperties: true
```

## zephyr/dts/bindings/zmk,behavior-sticky-layer.yaml
```yaml
title: "ZMK behavior-sticky-layer binding"

description: "Minimal binding for ZMK sticky-layer behavior to satisfy DTS parsing in this repo."

properties:
  layer:
    description: "Layer index to toggle/stick"
    type: integer
  quick-release:
    description: "If true, behave as quick-release sticky layer (deactivate after next key)"
    type: boolean

required: []

additionalProperties: true
```
